## block/Kconfig.iosched
```kconfig
# SPDX-License-Identifier: GPL-2.0
if BLOCK

menu "IO Schedulers"

config MQ_IOSCHED_DEADLINE
	tristate "MQ deadline I/O scheduler"
	default y
	---help---
	  MQ version of the deadline IO scheduler.

config MQ_IOSCHED_KYBER
	tristate "Kyber I/O scheduler"
	default y
	---help---
	  The Kyber I/O scheduler is a low-overhead scheduler suitable for
	  multiqueue and other fast devices. Given target latencies for reads and
	  synchronous writes, it will self-tune queue depths to achieve that
	  goal.

config IOSCHED_BFQ
	tristate "BFQ I/O scheduler"
	---help---
	BFQ I/O scheduler for BLK-MQ. BFQ distributes the bandwidth of
	of the device among all processes according to their weights,
	regardless of the device parameters and with any workload. It
	also guarantees a low latency to interactive and soft
	real-time applications.  Details in
	Documentation/block/bfq-iosched.rst

config BFQ_GROUP_IOSCHED
       bool "BFQ hierarchical scheduling support"
       depends on IOSCHED_BFQ && BLK_CGROUP
       ---help---

       Enable hierarchical scheduling in BFQ, using the blkio
       (cgroups-v1) or io (cgroups-v2) controller.

config BFQ_CGROUP_DEBUG
	bool "BFQ IO controller debugging"
	depends on BFQ_GROUP_IOSCHED
	---help---
	Enable some debugging help. Currently it exports additional stat
	files in a cgroup which can be useful for debugging.

endmenu

config BLK_ENHANCEMENT
	bool
	depends on BLK_CGROUP

config BLK_FATE_QOS
	bool
	depends on BLOCK_NON_GKI
	depends on BLK_ENHANCEMENT
	depends on !DEBUG_LOCK_ALLOC
	default y

config BLOCK_SOFTIRQ_TUNING
	bool

config PROC_VIRT_MEM
	bool

config BLOCK_NON_GKI
	bool "Block Layer Code Without GKI"
	select BLOCK_SOFTIRQ_TUNING
	select PROC_VIRT_MEM
	#select BLK_WBT
	select FCACHE_CTRL
	select BLK_ENHANCEMENT

config MQ_IOSCHED_VKYBER
	tristate "vkyber I/O scheduler"

endif
```

## drivers/fingerprint/Kconfig
```kconfig
menu "BBK FINGERPRINT support"
config BBK_FINGERPRINT
	tristate "BBK FINGERPRINT support"
	help
	  Say Y here to enable switch class support. This allows
	  monitoring switches by userspace via sysfs and uevent.


source "drivers/fingerprint/gf9518/Kconfig"
source "drivers/fingerprint/gf3658/Kconfig"
source "drivers/fingerprint/fpc1511/Kconfig"
endmenu
```

## drivers/fingerprint/gf3658/Kconfig
```kconfig
config BBK_GF3658
	tristate "Goodix GF3658 fingerprint drvier support"
	help
	  Say Y here to enable goodix fingerprint driver support!
```

## drivers/sarpower/Kconfig
```kconfig
menu "BBK SARPOWER support"
config BBK_SARPOWER
	tristate "BBK SARPOWER support"
	help
	  Say Y here to enable switch class support. This allows
	  monitoring switches by userspace via sysfs and uevent.

endmenu
```

## drivers/soc/vivo/Kconfig
```kconfig
menu "SOC (System On Chip) specific Drivers"

source "drivers/soc/vivo/src/Kconfig"
source "drivers/soc/vivo/vivo_bsp_engine/Kconfig"

endmenu
```

## drivers/soc/vivo/vivo_bsp_engine/Kconfig
```kconfig
config VIVO_BSP_ENGINE
	tristate "vivo bsp engine"
	help
	  This module provides bsp common support, and some useful debug method.
```

## drivers/usb/ext_typec/tcpc/Kconfig
```kconfig
#
# TypeC Port Controller Device Configuration
#

config TCPC_CLASS
	tristate "TypeC Port Controller Device Class"
	help
	  Say Y to enable
	  Typec Port
	  Controller Device
	  Class

config USB_POWER_DELIVERY
	tristate "Support USB power delivery Function"
	depends on TCPC_CLASS
	default n
	help
	  Say Y to enable
	  USB
	  Power Delivery
	  support

config DUAL_ROLE_USB_INTF
	tristate "Generic DUAL ROLE sysfs interface"
	help
	  A generic sysfs interface to track and change the state of
	  dual role usb phys. The usb phy drivers can register to
	  this interface to expose it capabilities to the userspace
	  and thereby allowing userspace to change the port mode.

config TCPC_RT1711H
	tristate "Richtek RT1711H TypeC port Controller Driver"
	depends on TCPC_CLASS
	default n
	help
	  Say Y to enable
	  Richtek RT1711H
	  TypeC port Controller
	  Driver

config TCPC_SGM7220
	tristate "SGM7220 TypeC port Controller Driver"
	depends on TCPC_CLASS
	default n
	help
	  Say Y to enable
	  SGM7220
	  TypeC port Controller
	  Driver

config TCPC_RT5081
	tristate "Richtek RT5081 TypeC port Controller Driver"
	depends on TCPC_CLASS
	default n
	help
	  Say Y to enable Richtek RT5081
	  TypeC port Controller
	  Also Support Power Delivery
	  Say N to disable

config TCPC_MT6362
	tristate "MT6362 SPMI TCPC driver"
	depends on TCPC_CLASS
	depends on MFD_MT6362
	select TCPC_ALERT_V20
	help
	  Say yes here to have support for the MT6362 TCPC
	  Support TypeC port Controller and Power Delivery

	  The driver can also be build as a module.
	  If so, the module will be called tcpci_mt6362

config TCPC_MT6370
	tristate "MediaTek MT6370 TypeC port Controller Driver"
	depends on TCPC_CLASS
	default n
	help
	  Say Y to enable MediaTek MT6370
	  TypeC port Controller
	  Also Support Power Delivery
	  Say N to disable

config USB_PD_VBUS_STABLE_TOUT
	int "PD VBUS Stable Timeout"
	depends on USB_POWER_DELIVERY
	range 0 1000                       # >= 0,  <= 1000
	default 125
	help
	  Setup a timeout value (ms)
	  for
	  VBUS change
	  stable

config PD_DBG_INFO
	tristate "PD debug information"
	depends on TCPC_CLASS
	default y
	help
	  Say Y to enable PD debug
	  information
	  Say N to disable
```

## techpack/display/vivo_lcm_ddic/Kconfig
```kconfig
config VIVO_LCM_DDIC
	tristate "VIVO LCM for SM5109C"
	depends on I2C && OF
	help
	  Say Y to enable the SM5109C DDIC driver for TI LMU devices.
	  This supports the DDIC device SM5109C.
```
